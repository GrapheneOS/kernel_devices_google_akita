// SPDX-License-Identifier: GPL-2.0-only
/*
 * Akita board device tree source
 *
 * Copyright 2022 Google LLC
 */

/dts-v1/;
/plugin/;

#include "zuma-akita-common.dtsi"

/ {
	board_id = <0x40402>;
	board_rev = <0x010003>;
	fragment@boardbase {
		target-path = "/";
		__overlay__ {
			model = "ZUMA AKITA Proto 1.0 Lassen GNSS board based on ZUMA B1";
			compatible = "google,ZUMA AKITA", "google,ZUMA";
		};
	};
};
