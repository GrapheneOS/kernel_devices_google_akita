// SPDX-License-Identifier: GPL-2.0-only
/*
 * Akita board-common device tree source.
 *
 * Copyright 2022 Google LLC
 */

#include "../google-dts-base/zuma-board.dtsi"

#include "zuma-akita-camera-pmic.dtsi"
#include "zuma-akita-usb.dtsi"
#include "zuma-akita-battery.dtsi"
#include "zuma-akita-charging.dtsi"
#include "zuma-akita-usecases.dtsi"
#include "zuma-akita-wcharger.dtsi"
#include "zuma-akita-gsa-gsc.dtsi"
#include "zuma-akita-wlan.dtsi"
#include "zuma-akita-cp-s5300-thermal-zone.dtsi"
