// SPDX-License-Identifier: GPL-2.0-only
/*
 * Board-common device tree source.
 *
 * Copyright 2022 Google LLC
 */

#include "../google-dts-base/zuma-common.dtsi"

#include "zuma-board-pcie.dtsi"
#include "zuma-board-wlan.dtsi"
#include "zuma-board-cp-s5300-sit.dtsi"
#include "zuma-board-bluetooth.dtsi"
#include "zuma-board-ese.dtsi"
#include "zuma-board-nfc.dtsi"
#include "zuma-board-gps.dtsi"
#include "zuma-board-udfps.dtsi"
#include "zuma-akita-camera-pmic.dtsi"
#include "zuma-akita-usb.dtsi"
#include "zuma-akita-battery.dtsi"
#include "zuma-akita-charging.dtsi"
#include "zuma-akita-usecases.dtsi"
#include "zuma-akita-wcharger.dtsi"
#include "zuma-akita-gsa-gsc.dtsi"


